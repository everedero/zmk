## app/boards/arm/apex_pro_mini/Kconfig.board
```kconfig
# STM32L412RB Nucleo board configuration

# Copyright (c) 2025 Eve Redero
# SPDX-License-Identifier: Apache-2.0

config BOARD_APEX_PRO_MINI
	bool "Steelseries Apex Pro Mini"
	depends on SOC_STM32L412XX
```

## app/boards/arm/apex_pro_mini/Kconfig.defconfig
```kconfig
# Steelseries Apex Pro Mini keyboard configuration

# Copyright (c) 2025 Eve Redero
# SPDX-License-Identifier: Apache-2.0

if BOARD_APEX_PRO_MINI

config BOARD
	default "apex_pro_mini"

config ZMK_KEYBOARD_NAME
    default "Apex Pro Mini"

config ZMK_KSCAN_MATRIX_POLLING
    default y

config SPI_STM32_INTERRUPT
	default y
	depends on SPI

endif # BOARD_APEX_PRO_MINI
```
