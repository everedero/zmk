## app/boards/apex_pro_mini.conf
```kconfig
CONFIG_CONSOLE=y
CONFIG_SERIAL=y
CONFIG_UART_CONSOLE=y
CONFIG_UART_INTERRUPT_DRIVEN=y
CONFIG_ZMK_USB=y
CONFIG_ZMK_KSCAN_MATRIX_POLLING=y
CONFIG_USB_CDC_ACM_LOG_LEVEL_OFF=y
CONFIG_SYSTEM_WORKQUEUE_STACK_SIZE=2048
```

## app/boards/apexpromini.conf
```kconfig
CONFIG_CONSOLE=y
CONFIG_SERIAL=y
CONFIG_UART_CONSOLE=y
CONFIG_UART_INTERRUPT_DRIVEN=y
CONFIG_ZMK_USB=y
CONFIG_ZMK_KSCAN_MATRIX_POLLING=y
```

## app/boards/arm/apexpromini/Kconfig.board
```kconfig
# STM32L412RB Nucleo board configuration

# Copyright (c) 2021 Guðni Már Gilbert
# SPDX-License-Identifier: Apache-2.0

config BOARD_APEXPROMINI
	bool "Nucleo L412RB-P Development Board"
	depends on SOC_STM32L412XX
```

## app/boards/arm/apexpromini/Kconfig.defconfig
```kconfig
# Steelseries Apex Pro Mini keyboard configuration

# Copyright (c) 2025 Eve Redero
# SPDX-License-Identifier: Apache-2.0

if BOARD_APEXPROMINI

config BOARD
	default "apexpromini"

config ZMK_KEYBOARD_NAME
    default "Apex Pro Mini"

config ZMK_KSCAN_MATRIX_POLLING
    default y

config SPI_STM32_INTERRUPT
	default y
	depends on SPI

endif # BOARD_APEXPROMINI
```
